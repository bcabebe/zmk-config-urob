## config/boards/shields/cs42_dual_aff/Kconfig.defconfig
```kconfig
if SHIELD_CS42_DUAL_AFF

config ZMK_KEYBOARD_NAME
	default "CS42-DUAL-AFF"

endif
```

## config/boards/shields/cs42_dual_nnv2/Kconfig.defconfig
```kconfig
if SHIELD_CS42_DUAL_NNV2

config ZMK_KEYBOARD_NAME
	default "CS42-DUAL-NNV2"

endif
```

## zmk-switch-layout/Kconfig
```kconfig
# Copyright (c) 2026 Marcos Chow Castro
# SPDX-License-Identifier: MIT

config ZMK_SWITCH_LAYOUT_STATE
    bool
    default y
    depends on DT_HAS_ZMK_SWITCH_LAYOUT_BEHAVIOR_SWITCH_LAYOUT_MODE_ENABLED && SETTINGS

config ZMK_SWITCH_LAYOUT_MODE_BEHAVIOR
    bool
    default y
    depends on ZMK_SWITCH_LAYOUT_STATE

config ZMK_SWITCH_LAYOUT_KEY_BEHAVIOR
    bool
    default y
    depends on ZMK_SWITCH_LAYOUT_STATE && DT_HAS_ZMK_SWITCH_LAYOUT_BEHAVIOR_SWITCH_LAYOUT_KEY_ENABLED
```

## zmk-switch-layout/dts/bindings/behaviors/zmk-switch-layout,behavior-switch-layout-key.yaml
```yaml
# Copyright (c) 2026 Marcos Chow Castro
# SPDX-License-Identifier: MIT

description: Keyboard-side layout key selector behavior

compatible: "zmk-switch-layout,behavior-switch-layout-key"

include: zero_param.yaml

properties:
  bindings:
    type: phandle-array
    required: true
    description: One binding per layout, in the same order used by switch-layout-mode.
```

## zmk-switch-layout/dts/bindings/behaviors/zmk-switch-layout,behavior-switch-layout-mode.yaml
```yaml
# Copyright (c) 2026 Marcos Chow Castro
# SPDX-License-Identifier: MIT

description: Persistent switch layout mode behavior

compatible: "zmk-switch-layout,behavior-switch-layout-mode"

include: one_param.yaml

properties:
  layout-count:
    type: int
    required: true
    description: Number of selectable keyboard-side layouts.
  default-layout:
    type: int
    required: false
    default: 0
    description: Layout used before saved settings are loaded.
```
